## config/boards/shields/slimredox/Kconfig.defconfig
```kconfig
# Copyright (c) 2021 The ZMK Contributors
# SPDX-License-Identifier: MIT
if SHIELD_SLIMREDOX_LEFT

config ZMK_KEYBOARD_NAME
    default "SlimRedox"

config ZMK_SPLIT_ROLE_CENTRAL
    default y

endif

if SHIELD_SLIMREDOX_LEFT || SHIELD_SLIMREDOX_RIGHT

config ZMK_SPLIT
    default y

endif
```

## config/boards/shields/slimredox/Kconfig.shield
```kconfig
# Copyright (c) 2021 The ZMK Contributors
# SPDX-License-Identifier: MIT
config SHIELD_SLIMREDOX_LEFT
    def_bool $(shields_list_contains,slimredox_left)

config SHIELD_SLIMREDOX_RIGHT
    def_bool $(shields_list_contains,slimredox_right)
# No whitespace after the comma or in the keyboard name!
#
config SHIELD_SLIMREDOX_DONGLE
    def_bool $(shields_list_contains,slimresox_dongle)
```
